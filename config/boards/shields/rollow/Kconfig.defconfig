## config/boards/shields/rollow/Kconfig.defconfig
```kconfig
if SHIELD_ROLLOW_LEFT || SHIELD_DONGLE

CONFIG_ZMK_USB_LOGGING=y


config ZMK_KEYBOARD_NAME
	default "Rollow Dongle"

# Another version (https://github.com/tomgroenwoldt/zmk-config/blob/master/config/boards/shields/corne/Kconfig.defconfig) uses ZMK_SPLIT_ROLE_CENTRAL instead and removes ZMK_BLE from below. That didn't work for connecting them in this config, so I'm not sure how that worked for them. But this has the side effect that you can potentially pair to it as BT device despite never wanting that with USB.
config ZMK_SPLIT_BLE_ROLE_CENTRAL
	default y

config ZMK_USB
    default y

endif

if  SHIELD_ROLLOW_LEFT || SHIELD_ROLLOW_RIGHT || SHIELD_DONGLE || SHIELD_ROLLOW_PERIPHERAL_LEFT

config ZMK_SPLIT
    default y

config ZMK_BLE
    default y

endif
```

## config/boards/shields/rollow/Kconfig.shield
```kconfig
# Copyright (c) 2020 Pete Johanson
# SPDX-License-Identifier: MIT

config SHIELD_ROLLOW_LEFT
	def_bool $(shields_list_contains,rollow_left)

config SHIELD_ROLLOW_RIGHT
	def_bool $(shields_list_contains,rollow_right)


config SHIELD_DONGLE
    def_bool $(shields_list_contains,dongle)

config SHIELD_ROLLOW_PERIPHERAL_LEFT
    def_bool $(shields_list_contains,rollow_peripheral_left)
```

## config/west.yml
```yaml
manifest:
  remotes:
    - name: zmkfirmware
      url-base: https://github.com/zmkfirmware
    - name: nickconway
      url-base: https://github.com/nickconway
    - name: split-encoder
      url-base: https://github.com/petejohanson
  projects:
    - name: zmk
      remote: zmkfirmware
      revision: main
      import: app/west.yml
  self:
    path: config
```
